## package/link4all/ar8035_phy/config.in
```kconfig
if PACKAGE_kmod-ar8035
config AR8035
	tristate "Just a example"
	default y
endif
```

## package/link4all/cdc-encap/src/Kconfig
```kconfig
config CDC_ENCAP
    tristate "support zte me3760"
    help
        it is a driver to support zte 4g module me3760
```

## package/link4all/gobinet/driver_V15/Kconfig
```kconfig
config USB_NET_GOBINET
    tristate "support qca9x07"
    help
        it is a driver to support qca9x07
```

## package/link4all/tuoshi/lc-ltencm/src/Kconfig
```kconfig
config LC_LTENCM
    tristate "NCM support LeadCore/tuoshi 4g modem"
    help
        it is a NCM driver to support LeadCore/tuoshi 4g modem
```

## package/link4all/tuoshi/lc-ltetty/src/Kconfig
```kconfig
config LC_LTETTY
    tristate "support LeadCore/tuoshi 4g modem"
    help
        it is a driver to support LeadCore/tuoshi 4g modem
```

## package/shellgui/whsnbg/Config.in
```kconfig
# whsnbg config

menu  "Configuration"
    depends on PACKAGE_whsnbg
	
	config WHSNBG_DAEMON
		bool "Daemon version"
		default y
		help
			Builds the daemon version

	config WHSNBG_DPRINTF
		bool "Detailed log"
		default n
		help
			Enables detailed debug log

	config WHSNBG_RULES_ENGINE
		bool "Rules engine"
		default n
		help
			Enables rules engine thread

	choice
		prompt "TLS support"
		default WHSNBG_NOTLS_LIBRARY
		help
			The library to enable TLS support
		config WHSNBG_NOTLS_LIBRARY
			bool "None"
		config WHSNBG_AXTLS_LIBRARY
			bool "axTLS"
			select PACKAGE_libaxtls
		config WHSNBG_OPENSSL_LIBRARY
			bool "OpenSSL"
			select PACKAGE_libopenssl
	endchoice

	menuconfig WHSNBG_SENSOR_DATA
		bool "HomeWSN.com sensors support"
		default n
		help
			Automatic decoding of the MQTT-SN message payload from the sensors

		config WHSNBG_SENSOR_DATA_MYSQL
			bool "Storing decoded data from the sensors in the MySQL database" if WHSNBG_SENSOR_DATA
			default n
			select PACKAGE_libmysqlclient
			help
				Storing decoded data from the sensors in the MySQL database

		config WHSNBG_MQTT_DATA_MYSQL
			bool "Storing payload from the specific MQTT topics in the MySQL database" if WHSNBG_SENSOR_DATA
			default n
			select PACKAGE_libmysqlclient
			help
				Storing payload from the specific MQTT topics in the MySQL database

	config WHSNBG_STATIC
		bool "Static link"
		default n
		help
			Builds the static link version

endmenu
```
